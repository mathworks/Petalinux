## mw_kria_kv260/project-spec/configs/rootfsconfigs/Kconfig.user
```kconfig
menu "user packages " 
config libiio  
	 bool "libiio"
	 help
	
config libserialport  
	 bool "libserialport"
	 help
	
config boost  
	 bool "boost"
	 help
	
config gpio-demo  
	 bool "gpio-demo"
	 help
	
config lttng-ust  
	 bool "lttng-ust"
	 help
	
config mw-fs-overlay  
	 bool "mw-fs-overlay"
	 help
	
config packagegroup-petalinux-kria  
	 bool "packagegroup-petalinux-kria"
	 help
	
config peekpoke  
	 bool "peekpoke"
	 help
	
config rfdc  
	 bool "rfdc"
	 help
	
config rfdc-read-write  
	 bool "rfdc-read-write"
	 help
	
config rfdc-selftest  
	 bool "rfdc-selftest"
	 help
	
endmenu
```

## mw_te0820/project-spec/meta-mathworks/conf/layer.conf
```bitbake
# We have a conf and classes directory, add to BBPATH
BBPATH .= ":${LAYERDIR}"

# We have recipes-* directories, add to BBFILES
BBFILES += "${LAYERDIR}/recipes-*/*/*.bb \
            ${LAYERDIR}/recipes-*/*/*.bbappend"

BBFILE_COLLECTIONS += "meta-mathworks"
BBFILE_PATTERN_meta-mathworks = "^${LAYERDIR}/"
BBFILE_PRIORITY_meta-mathworks = "10"

LAYERDEPENDS_meta-mathworks = "core"
LAYERDEPENDS_meta-mathworks += "xilinx"
LAYERDEPENDS_meta-mathworks += "xilinx-tools"
LAYERDEPENDS_meta-mathworks += "openembedded-layer"

LAYERSERIES_COMPAT_meta-mathworks = "gatesgarth honister"
```

## mw_zcu104/project-spec/configs/rootfsconfigs/Kconfig.user
```kconfig
menu "user packages " 
config gpio-demo  
	 bool "gpio-demo"
	 help
	
config gstreamer-vcu-examples  
	 bool "gstreamer-vcu-examples"
	 help
	
config gstreamer-vcu-notebooks  
	 bool "gstreamer-vcu-notebooks"
	 help
	
config mw-fs-overlay  
	 bool "mw-fs-overlay"
	 help
	
config packagegroup-petalinux-audio  
	 bool "packagegroup-petalinux-audio"
	 help
	
config packagegroup-petalinux-v4lutils  
	 bool "packagegroup-petalinux-v4lutils"
	 help
	
config peekpoke  
	 bool "peekpoke"
	 help
	
endmenu
```

## mw_zcu106/project-spec/configs/rootfsconfigs/Kconfig.user
```kconfig
menu "user packages " 
config libiio  
	 bool "libiio"
	 help
	
config libserialport  
	 bool "libserialport"
	 help
	
config boost  
	 bool "boost"
	 help
	
config boost-dev  
	 bool "boost-dev"
	 help
	
config gpio-demo  
	 bool "gpio-demo"
	 help
	
config lttng-ust  
	 bool "lttng-ust"
	 help
	
config lttng-ust-bin  
	 bool "lttng-ust-bin"
	 help
	
config mw-fs-overlay  
	 bool "mw-fs-overlay"
	 help
	
config peekpoke  
	 bool "peekpoke"
	 help
	
endmenu
```

## mw_zcu208/project-spec/configs/rootfsconfigs/Kconfig.user
```kconfig
menu "user packages " 
config libiio  
	 bool "libiio"
	 help
	
config libsdfecusrintf  
	 bool "libsdfecusrintf"
	 help
	
config libserialport  
	 bool "libserialport"
	 help
	
config boost  
	 bool "boost"
	 help
	
config boost-dev  
	 bool "boost-dev"
	 help
	
config gpio-demo  
	 bool "gpio-demo"
	 help
	
config lttng-ust  
	 bool "lttng-ust"
	 help
	
config lttng-ust-bin  
	 bool "lttng-ust-bin"
	 help
	
config mw-fs-overlay  
	 bool "mw-fs-overlay"
	 help
	
config mw-refdesign-dtb  
	 bool "mw-refdesign-dtb"
	 help
	
config mw-rf-init  
	 bool "mw-rf-init"
	 help
	
config peekpoke  
	 bool "peekpoke"
	 help
	
config rfclk  
	 bool "rfclk"
	 help
	
config rfdc  
	 bool "rfdc"
	 help
	
config rfdc-read-write  
	 bool "rfdc-read-write"
	 help
	
config rfdc-selftest  
	 bool "rfdc-selftest"
	 help
	
config rftool-zcu208  
	 bool "rftool-zcu208"
	 help
	
config rftool-zcu670  
	 bool "rftool-zcu670"
	 help
	
config sdfec-demo  
	 bool "sdfec-demo"
	 help
	
endmenu
```

## mw_zcu670/project-spec/configs/rootfsconfigs/Kconfig.user
```kconfig
menu "user packages " 
config libiio  
	 bool "libiio"
	 help
	
config libsdfecusrintf  
	 bool "libsdfecusrintf"
	 help
	
config libserialport  
	 bool "libserialport"
	 help
	
config boost  
	 bool "boost"
	 help
	
config boost-dev  
	 bool "boost-dev"
	 help
	
config dfeccf  
	 bool "dfeccf"
	 help
	
config dfeequ  
	 bool "dfeequ"
	 help
	
config dfemix  
	 bool "dfemix"
	 help
	
config dfeofdm  
	 bool "dfeofdm"
	 help
	
config dfeprach  
	 bool "dfeprach"
	 help
	
config gpio-demo  
	 bool "gpio-demo"
	 help
	
config lttng-ust  
	 bool "lttng-ust"
	 help
	
config lttng-ust-bin  
	 bool "lttng-ust-bin"
	 help
	
config mw-fs-overlay  
	 bool "mw-fs-overlay"
	 help
	
config mw-rf-init  
	 bool "mw-rf-init"
	 help
	
config peekpoke  
	 bool "peekpoke"
	 help
	
config python3-cffi  
	 bool "python3-cffi"
	 help
	
config python3-pyro4  
	 bool "python3-pyro4"
	 help
	
config rfclk  
	 bool "rfclk"
	 help
	
config rfdc  
	 bool "rfdc"
	 help
	
config rfdc-read-write  
	 bool "rfdc-read-write"
	 help
	
config rfdc-selftest  
	 bool "rfdc-selftest"
	 help
	
config rftool-zcu670  
	 bool "rftool-zcu670"
	 help
	
config sdfec-demo  
	 bool "sdfec-demo"
	 help
	
endmenu
```
