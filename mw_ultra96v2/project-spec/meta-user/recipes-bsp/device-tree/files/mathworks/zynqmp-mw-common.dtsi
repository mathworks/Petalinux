/{
	core_clkwiz: clockwiz0 {
		compatible = "fixed-clock";
		#clock-cells = <0>;
		clock-frequency = <50000000>;
	};
};

&fpga_axi {
	mwipcore0: mwipcore@A0000000 {
		compatible = "mathworks,mwipcore-v3.00";
		reg = <0xA0000000 0x10000>;
	};
};

