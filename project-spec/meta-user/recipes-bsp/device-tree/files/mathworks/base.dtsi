/* Avnet: defer to zcu111 dts in the bsp 
#include "zynqmp-zcu102-rev1.0.dts"
*/

/* Avnet: defer to chosen in zcu111 bsp
/ {
	chosen {
		bootargs = "earlycon root=/dev/ram rw";
	};
};
*/

#include "zynqmp-mw-fpga-bridge-common.dtsi"
#include "zynqmp-mw-common.dtsi"
#include "mw-aximm-common.dtsi"
