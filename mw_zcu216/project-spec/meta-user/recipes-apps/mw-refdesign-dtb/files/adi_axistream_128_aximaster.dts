#include "base.dtsi"

#undef MW_MM2S_DATAFMT
#undef MW_S2MM_DATAFMT

#define MW_MM2S_DATAFMT "u128/128>>0"
#define MW_S2MM_DATAFMT "u128/128>>0"

#include "zynqmp-adi-mw-axistream-iio-common.dtsi"
#include "zynqmp-mw-sharedmem-iio-common.dtsi"
/* define the PL DDR size */
#define MW_PLDDR_SIZE_1 (0x00000000)
#define MW_PLDDR_SIZE_0 (0x20000000) // 512 MB
#include "zynqmp-mw-sharedmem-iio-plmem.dtsi"
