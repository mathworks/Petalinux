/{
	core_clkwiz: clockwiz0 {
		compatible = "fixed-clock";
		#clock-cells = < 0x01 >;
		clock-frequency = < 0x2faf080 >;	
	};
};

&fpga_axi {
		mwipcore0: mwipcore@A0000000 {
			compatible = "mathworks,mwipcore-v3.00";
			reg = <0xA0000000 0x10000>;
		};
};

