/* Create the common FPGA AXI bus and clock */
/ {
	fpga_axi: fpga-axi@0 {
		compatible = "simple-bus";
		interrupt-parent = <&intc>;
		#address-cells = <0x1>;
		#size-cells = <0x1>;
		ranges;
	};
	core_clkwiz: clockwiz0 {
		compatible = "fixed-clock";
		#clock-cells = <1>;
		clock-frequency = < 0x2faf080 >;
	};
};

/* Setup the default boot args for ramdisk and earlycon */
/ {
	chosen {
		bootargs = "earlycon root=/dev/ram rw";
	};
};
