#include "zcu104-revc.dtsi"

/ {
	chosen {
		bootargs = "earlycon root=/dev/ram rw";
	};
};
#include "zynqmp-mw-fpga-bridge-common.dtsi"
#include "zynqmp-mw-common.dtsi"
#include "mw-aximm-common.dtsi"
