&gem1 {
        phy-mode = "gmii";
        status = "okay";
        snps,reset-gpio = <&gpio0 51 0>;
        snps,reset-active-low;
        snps,reset-delays-us = <0 10000 1000000>;

        mdio {
                #address-cells = <1>;
                #size-cells = <0>;
                phy1: ethernet-phy@1 {
                        reg = <1>;
                };
        };
};
